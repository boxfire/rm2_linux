## Documentation/devicetree/bindings/input/touchscreen/wacom,generic.yaml
```yaml
# SPDX-License-Identifier: (GPL-2.0 OR BSD-2-Clause)
%YAML 1.2
---
$id: http://devicetree.org/schemas/input/touchscreen/wacom,generic.yaml#
$schema: http://devicetree.org/meta-schemas/core.yaml#

title: Wacom I2C Controller

maintainers:
  - Alistair Francis <alistair@alistair23.me>

allOf:
  - $ref: touchscreen.yaml#

properties:
  compatible:
    const: wacom,generic

  reg:
    maxItems: 1

  interrupts:
    maxItems: 1

  vdd-supply:
    maxItems: 1

required:
  - compatible
  - reg
  - interrupts

additionalProperties: false

examples:
  - |
    #include "dt-bindings/interrupt-controller/irq.h"
    i2c {
        #address-cells = <1>;
        #size-cells = <0>;
        digitiser@9 {
                compatible = "wacom,generic";
                reg = <0x9>;
                interrupt-parent = <&gpio1>;
                interrupts = <9 IRQ_TYPE_LEVEL_LOW>;
                vdd-supply = <&reg_touch>;
        };
    };
```

## Documentation/devicetree/bindings/input/touchscreen/wacom,wacom-i2c.yaml
```yaml
# SPDX-License-Identifier: (GPL-2.0 OR BSD-2-Clause)
%YAML 1.2
---
$id: http://devicetree.org/schemas/input/touchscreen/wacom,wacom-i2c.yaml#
$schema: http://devicetree.org/meta-schemas/core.yaml#

title: Wacom I2C Controller

maintainers:
  - Alistair Francis <alistair@alistair23.me>

allOf:
  - $ref: touchscreen.yaml#

properties:
  compatible:
    const: wacom,wacom-i2c

  reg:
    maxItems: 1

  interrupts:
    maxItems: 1

  flip-tilt-x:
  flip-tilt-y:
  flip-pos-x:
  flip-pos-y:
  flip-distance:

required:
  - compatible
  - reg
  - interrupts

additionalProperties: false

examples:
  - |
    #include "dt-bindings/interrupt-controller/irq.h"
    i2c {
        #address-cells = <1>;
        #size-cells = <0>;
        digitiser@9 {
                compatible = "wacom,wacom-i2c";
                reg = <0x9>;
                interrupt-parent = <&gpio1>;
                interrupts = <9 IRQ_TYPE_LEVEL_LOW>;
                flip-tilt-x;
                flip-tilt-y;
                flip-pos-x;
                flip-pos-y;
                flip-distance;
        };
    };
```

## Documentation/devicetree/bindings/mfd/silergy,sy7636a.yaml
```yaml
# SPDX-License-Identifier: GPL-2.0-only OR BSD-2-Clause
%YAML 1.2
---
$id: http://devicetree.org/schemas/mfd/silergy,sy7636a.yaml#
$schema: http://devicetree.org/meta-schemas/core.yaml#

title: silergy sy7636a PMIC

maintainers:
  - Alistair Francis <alistair@alistair23.me>

properties:
  compatible:
    const: silergy,sy7636a

  reg:
    maxItems: 1

  '#thermal-sensor-cells':
    const: 0

  regulators:
    type: object
    $ref: /schemas/regulator/regulator.yaml#

    properties:
      compatible:
        const: silergy,sy7636a-regulator

      regulator-name:
        pattern: "vcom"

required:
  - compatible
  - reg
  - '#thermal-sensor-cells'

additionalProperties: false

examples:
  - |
    i2c {
      #address-cells = <1>;
      #size-cells = <0>;

      sy7636a@62 {
        compatible = "silergy,sy7636a";
        reg = <0x62>;
        status = "okay";
        pinctrl-names = "default";
        pinctrl-0 = <&pinctrl_epdpmic>;
        #thermal-sensor-cells = <0>;

        regulators {
          compatible = "silergy,sy7636a-regulator";
          reg_epdpmic: vcom {
            regulator-name = "vcom";
            regulator-boot-on;
          };
        };
      };
    };
...
```

## Documentation/devicetree/bindings/regulator/silergy,sy7636a.yaml
```yaml
# SPDX-License-Identifier: (GPL-2.0-only OR BSD-2-Clause)
%YAML 1.2
---
$id: http://devicetree.org/schemas/regulator/silergy,sy7636a-regulator.yaml#
$schema: http://devicetree.org/meta-schemas/core.yaml#

title: silergy sy7636a PMIC

maintainers:
  - Alistair Francis <alistair@alistair23.me>

allOf:
  - $ref: regulator.yaml#

properties:
  compatible:
    enum:
      - sy7636a-regulator

required:
  - compatible

unevaluatedProperties: false

examples:
  - |
    i2c {
        #address-cells = <1>;
        #size-cells = <0>;
        regulator@60 {
          compatible = "sy7636a-regulator";
          reg_epdpmic: vcom {
            regulator-name = "vcom";
            regulator-boot-on;
          };
        };
    };

...
```
